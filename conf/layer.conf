## conf/layer.conf
```bitbake
BBPATH ?= ""
# We have a conf and classes directory, add to BBPATH
BBPATH =. "${LAYERDIR}:"

# We have a packages directory, add to BBFILES
BBFILES += " ${LAYERDIR}/recipes-*/*/*.bb "
BBFILES += "${@bb.utils.contains('MACHINE', 'nxp-lx2xxx', '${LAYERDIR}/recipes-*/*/*.bbappend', '', d)}"

BBFILE_COLLECTIONS += "nxp-lx2xxx"
BBFILE_PATTERN_nxp-lx2xxx := "^${LAYERDIR}/"
BBFILE_PRIORITY_nxp-lx2xxx = "7"

PREFERRED_PROVIDER_virtual/kernel ?= "linux-yocto"

# This should only be incremented on significant changes that will
# cause compatibility issues with other layers
LAYERVERSION_nxp-lx2xxx = "1"

LAYERDEPENDS_nxp-lx2xxx = "core wrlinux"
LAYERDEPENDS_nxp-lx2xxx = "freescale-layer"
```

## conf/machine/nxp-lx2xxx.conf
```bitbake
#@TYPE: Machine
#@NAME: nxp-lx2xxx
#@DESCRIPTION: Machine configuration for NXP Layerscape LX2160A SoC

DEFAULTTUNE = "aarch64"
require conf/machine/include/arm/arch-armv8.inc

MACHINE_FEATURES = "ext3 pci usbgadget usbhost vfat"

KERNEL_IMAGETYPE = "Image"
KERNEL_DEVICETREE = "freescale/fsl-lx2160a-rdb.dtb"

SERIAL_CONSOLES ?= "115200;ttyS0"
SERIAL_CONSOLES_CHECK ?= "${SERIAL_CONSOLES}"

IMAGE_FSTYPES += "tar.bz2"

# multilib support
MULTILIBS ?= "multilib:lib32"
DEFAULTTUNE_virtclass-multilib-lib32 ?= "armv7athf-neon"
EXTRA_IMAGECMD_jffs2 = "--pad --no-cleanmarkers --eraseblock=128"

MACHINE_EXTRA_RRECOMMENDS = " kernel-modules kernel-devicetree"
IMAGE_FSTYPES += "tar.bz2 wic wic.bmap"
WKS_FILE ?= "lx2xxx-sdimage-bootpart.wks"
IMAGE_INSTALL_append = " kernel-devicetree kernel-image-image"
do_image_wic[depends] += "mtools-native:do_populate_sysroot dosfstools-native:do_populate_sysroot"
IMAGE_BOOT_FILES ?= " Image fsl-lx2160a-rdb.dtb"

# it's used by many recipes in meta-freescale
MACHINE_SOCARCH = "${TUNE_PKGARCH}"

DPDK_TARGET_MACHINE ?= "dpaa2"
PREFERRED_VERSION_dpdk = "17.11.1"
```
